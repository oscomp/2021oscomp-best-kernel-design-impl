/*********************************************************************************************************
**
**                                    中国软件开源组织
**
**                                   嵌入式实时操作系统
**
**                                       SylixOS(TM)
**
**                               Copyright  All Rights Reserved
**
**--------------文件信息--------------------------------------------------------------------------------
**
** 文   件   名: config.ld
**
** 创   建   人: RealEvo-IDE
**
** 文件创建日期: 2021 年 03 月 25 日
**
** 描        述: 本文件由 RealEvo-IDE 生成，用于配置链接脚本
*********************************************************************************************************/

#include "config.h"

/*********************************************************************************************************
    内存布局定义
*********************************************************************************************************/

MEMORY
{
  TEXT (rx) : ORIGIN = BSP_CFG_RAM_BASE, LENGTH = BSP_CFG_TEXT_SIZE
  DATA (rw) : ORIGIN = BSP_CFG_RAM_BASE + (BSP_CFG_TEXT_SIZE), LENGTH = BSP_CFG_DATA_SIZE
}

BOOT_STACK_SIZE = BSP_CFG_BOOT_STACK_SIZE;

/*********************************************************************************************************
  END
*********************************************************************************************************/
